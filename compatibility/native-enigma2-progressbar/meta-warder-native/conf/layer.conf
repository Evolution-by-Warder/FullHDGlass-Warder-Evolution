## compatibility/native-enigma2-progressbar/meta-warder-native/conf/layer.conf
```bitbake
BBPATH .= ":${LAYERDIR}"
BBFILES += "${LAYERDIR}/recipes-oe-alliance/*/*.bbappend"
BBFILE_COLLECTIONS += "wardernative"
BBFILE_PATTERN_wardernative := "^${LAYERDIR}/"
BBFILE_PRIORITY_wardernative = "7"
LAYERSERIES_COMPAT_wardernative = "wrynose blacksail"
```
